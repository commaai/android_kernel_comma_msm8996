/*
 * Copyright (c) 2015 The Linux Foundation. All rights reserved.
 *
 * This program is free software; you can redistribute it and/or modify
 * it under the terms of the GNU General Public License version 2 and
 * only version 2 as published by the Free Software Foundation.
 *
 * This program is distributed in the hope that it will be useful,
 * but WITHOUT ANY WARRANTY; without even the implied warranty of
 * MERCHANTABILITY or FITNESS FOR A PARTICULAR PURPOSE.  See the
 * GNU General Public License for more details.
 */

/*
 * Note: default configuration is for self-powered camera modules.
 */
&cci {
	qcom,camera@2 {
		cell-index = <2>;
		compatible = "qcom,camera";
		reg = <0x02>;
		qcom,csiphy-sd-index = <2>;
		qcom,csid-sd-index = <2>;
		qcom,mount-angle = <0>;
		qcom,sensor-name = "ov10640";
		cam_vdig-supply = <&vph_pwr_vreg>;
		cam_vio-supply = <&vph_pwr_vreg>;
		cam_vana-supply = <&vph_pwr_vreg>;
		qcom,cam-vreg-name = "cam_vdig", "cam_vio", "cam_vana";
		qcom,cam-vreg-min-voltage = <1000000 0 3150000>;
		qcom,cam-vreg-max-voltage = <1000000 0 3600000>;
		qcom,cam-vreg-op-mode = <105000 0 80000>;
		qcom,gpio-no-mux = <0>;
		pinctrl-names = "cam_default", "cam_suspend";
		pinctrl-0 = <&cam_sensor_mclk2_active &cam_csi2_sensor_active>;
		pinctrl-1 = <&cam_sensor_mclk2_suspend
				&cam_csi2_sensor_suspend>;
		gpios = <&tlmm 15 0>,
			<&tlmm 23 0>,
			<&tlmm 26 0>;
		qcom,gpio-reset = <1>;
		qcom,gpio-standby = <2>;
		qcom,gpio-req-tbl-num = <0 1 2>;
		qcom,gpio-req-tbl-flags = <1 0 0>;
		qcom,gpio-req-tbl-label = "CAMIF_MCLK2",
					  "CAM_RESET2",
					  "CAM_STANDBY2";
		qcom,sensor-position = <2>;
		qcom,sensor-mode = <0>;
		qcom,cci-master = <1>;
		qcom,i2c-freq-mode = <1>;
		qcom,slave-addr = <0x30>;

		qcom,cam-power-seq-type = "sensor_gpio", "sensor_vreg", "sensor_vreg",
			"sensor_vreg", "sensor_clk" , "sensor_gpio";
		qcom,cam-power-seq-val = "sensor_gpio_reset", "cam_vio", "cam_vana",
			"cam_vdig", "sensor_cam_mclk","sensor_gpio_reset";
		qcom,cam-power-seq-cfg-val = <0 1 1 1 24000000 1>;
		qcom,cam-power-seq-delay = <5 0 0 0 1 1>;

		status = "ok";
		clocks = <&clock_mmss clk_mclk2_clk_src>,
			<&clock_mmss clk_camss_mclk2_clk>;
		clock-names = "cam_src_clk", "cam_clk";
	};
};
